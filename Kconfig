## Kconfig
```kconfig
# SPDX-FileCopyrightText: 2026 roolrz
# SPDX-License-Identifier: Apache-2.0

config SYSTEM_APP_UMOUNT_SYSTEM
    bool "umount-system (/bin/umount)"
    default y
    depends on SYSTEM_APP_FS_BACKEND_SYSTEM
    help
        Build and deploy hyper-umount-system at /bin/umount.
```
